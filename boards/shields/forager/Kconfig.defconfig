## boards/shields/forager/Kconfig.defconfig
```kconfig
if SHIELD_FORAGER_LEFT

config ZMK_KEYBOARD_NAME
  default "Forager"

config ZMK_SPLIT_ROLE_CENTRAL
  default y

endif

if SHIELD_FORAGER_DONGLE

config ZMK_KEYBOARD_NAME
  default "Forager"

config ZMK_SPLIT_ROLE_CENTRAL
  default y

config ZMK_SPLIT_BLE_CENTRAL_PERIPHERALS
  default 2

endif

if SHIELD_FORAGER_LEFT || SHIELD_FORAGER_RIGHT || SHIELD_FORAGER_DONGLE

config ZMK_SPLIT
  default y

endif
```

## boards/shields/forager/boards/nrf52840_mdk_usb_dongle.conf
```kconfig
# The Makerdiary MDK USB dongle is a Zephyr-tree board, so ZMK's usual
# board defconfig (cf. nice_nano_v2 / seeeduino_xiao_ble) doesn't apply;
# enable the same features here.
CONFIG_ZMK_USB=y
CONFIG_ZMK_BLE=y

# Persist BLE bonds in the storage partition.
CONFIG_MPU_ALLOW_FLASH_WRITE=y
CONFIG_FLASH=y
CONFIG_FLASH_PAGE_LAYOUT=y
CONFIG_FLASH_MAP=y
CONFIG_NVS=y
CONFIG_SETTINGS_NVS=y

# Stock UF2Boot expects apps at 0x1000 with family 0xADA52840, which is
# exactly what this board target produces. Drop this if the dongle turns
# out to run Nordic's open bootloader (flash the .hex via nrfutil instead).
CONFIG_BUILD_OUTPUT_UF2=y
```
